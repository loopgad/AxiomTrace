## baremetal/ports/esp32/Kconfig
```kconfig
# AxiomTrace ESP32 Kconfig
#
# ESP-IDF Kconfig integration for AxiomTrace ESP32 port.
# Place this file in the same directory as CMakeLists.txt.
#

menu "AxiomTrace ESP32 Configuration"

    config AXIOM_ESP32_ENABLE
        bool "Enable AxiomTrace ESP32 Port"
        default y
        help
            Enable AxiomTrace platform support for ESP32.

    config AXIOM_ESP32_UART_NUM
        int "UART port number"
        default 1
        range 0 2
        help
            UART peripheral to use for AxiomTrace output.
            0 = UART0 (typically used for console)
            1 = UART1 (available for custom use)
            2 = UART2 (available for custom use)

    config AXIOM_ESP32_UART_TX_GPIO
        int "UART TX GPIO pin"
        default 10
        help
            GPIO pin number for UART TX.
            Make sure this pin is available on your board and not used by SPI Flash.
            For UART1 default pins (GPIO10/9), they may conflict with SPI flash.
            Consider using: 17/16 (UART2) or configure via GPIO Matrix.

    config AXIOM_ESP32_UART_RX_GPIO
        int "UART RX GPIO pin"
        default 9
        help
            GPIO pin number for UART RX.
            Make sure this pin is available on your board and not used by SPI Flash.

    config AXIOM_ESP32_UART_BAUD
        int "UART baud rate"
        default 921600
        help
            UART baud rate for AxiomTrace output.
            Higher rates (921600) recommended for production.
            115200 can be used for debugging.

    config AXIOM_ESP32_UART_TX_BUF_SIZE
        int "UART TX buffer size"
        default 256
        range 64 1024
        help
            UART TX ring buffer size in bytes.
            Larger buffers can handle burst traffic better.

    config AXIOM_ESP32_UART_COBS_ENABLED
        bool "Enable COBS encoding"
        default y
        help
            Enable Consistent Overhead Byte Stuffing (COBS) encoding.
            COBS ensures 0x00 can be used as frame delimiter.

endmenu
```
